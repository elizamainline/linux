## Documentation/devicetree/bindings/clock/qcom,eliza-camcc.yaml
```yaml
# SPDX-License-Identifier: (GPL-2.0-only OR BSD-2-Clause)
%YAML 1.2
---
$id: http://devicetree.org/schemas/clock/qcom,eliza-camcc.yaml#
$schema: http://devicetree.org/meta-schemas/core.yaml#

title: Qualcomm Camera Clock & Reset Controller on Eliza

maintainers:
  - Taniya Das <taniya.das@oss.qualcomm.com>

description: |
  Qualcomm camera clock control module provides the clocks, resets and power
  domains on Eliza.

  See also:
    include/dt-bindings/clock/qcom,eliza-camcc.h
    include/dt-bindings/clock/qcom,eliza-cambistmclkcc.h

properties:
  compatible:
    enum:
      - qcom,eliza-cambistmclkcc
      - qcom,eliza-camcc

  clocks:
    items:
      - description: Camera AHB clock from GCC
      - description: Board XO source
      - description: Sleep clock source

required:
  - compatible
  - clocks

allOf:
  - $ref: qcom,gcc.yaml#

unevaluatedProperties: false

examples:
  - |
    #include <dt-bindings/clock/qcom,eliza-gcc.h>
    clock-controller@ade0000 {
        compatible = "qcom,eliza-camcc";
        reg = <0x0ade0000 0x20000>;
        clocks = <&gcc GCC_CAMERA_AHB_CLK>,
                 <&bi_tcxo_div2>,
                 <&sleep_clk>;
        #clock-cells = <1>;
        #reset-cells = <1>;
        #power-domain-cells = <1>;
    };

...
```

## Documentation/devicetree/bindings/display/panel/boe,rm69260-froggerpro.yaml
```yaml
# SPDX-License-Identifier: (GPL-2.0-only OR BSD-2-Clause)
%YAML 1.2
---
$id: http://devicetree.org/schemas/display/panel/boe,rm69260-froggerpro.yaml#
$schema: http://devicetree.org/meta-schemas/core.yaml#

title: BOE RM69260 AMOLED panel for the Nothing Phone (4a) Pro

maintainers:
  - Oleksii Onchul <oleksiionchul@gmail.com>

allOf:
  - $ref: panel-common.yaml#

properties:
  compatible:
    const: boe,rm69260-froggerpro

  reg:
    maxItems: 1

  vddio-supply:
    description: 1.8 V panel I/O supply

  dvdd-supply:
    description: 1.8 V panel digital supply

  vci-supply:
    description: 3.0 V panel analog supply

  reset-gpios:
    maxItems: 1

  pinctrl-0: true

  pinctrl-names:
    const: default

  port: true

required:
  - compatible
  - reg
  - vddio-supply
  - dvdd-supply
  - vci-supply
  - reset-gpios
  - port

additionalProperties: false

examples:
  - |
    #include <dt-bindings/gpio/gpio.h>

    dsi {
        #address-cells = <1>;
        #size-cells = <0>;

        panel@0 {
            compatible = "boe,rm69260-froggerpro";
            reg = <0>;
            vddio-supply = <&vddio>;
            dvdd-supply = <&dvdd>;
            vci-supply = <&vci>;
            reset-gpios = <&tlmm 12 GPIO_ACTIVE_LOW>;

            port {
                panel_in: endpoint {
                    remote-endpoint = <&dsi_out>;
                };
            };
        };
    };
...
```

## Documentation/devicetree/bindings/input/ics,rt6010.yaml
```yaml
# SPDX-License-Identifier: (GPL-2.0-only OR BSD-2-Clause)
%YAML 1.2
---
$id: http://devicetree.org/schemas/input/ics,rt6010.yaml#
$schema: http://devicetree.org/meta-schemas/core.yaml#

title: ICSense RT6010 LRA haptic controller

maintainers:
  - Oleksii Onchul <oleksiionchul@gmail.com>

properties:
  compatible:
    const: ics,rt6010

  reg:
    maxItems: 1

  reset-gpios:
    maxItems: 1

  interrupts:
    maxItems: 1

required:
  - compatible
  - reg
  - reset-gpios

additionalProperties: false

examples:
  - |
    #include <dt-bindings/gpio/gpio.h>
    #include <dt-bindings/interrupt-controller/irq.h>

    i2c {
        #address-cells = <1>;
        #size-cells = <0>;

        vibrator@5f {
            compatible = "ics,rt6010";
            reg = <0x5f>;
            reset-gpios = <&tlmm 30 GPIO_ACTIVE_LOW>;
            interrupts-extended = <&tlmm 116 IRQ_TYPE_LEVEL_LOW>;
        };
    };
```

## Documentation/devicetree/bindings/input/touchscreen/focaltech,ft3680.yaml
```yaml
# SPDX-License-Identifier: (GPL-2.0-only OR BSD-2-Clause)
%YAML 1.2
---
$id: http://devicetree.org/schemas/input/touchscreen/focaltech,ft3680.yaml#
$schema: http://devicetree.org/meta-schemas/core.yaml#

title: FocalTech FT3680 and FT3683G SPI touchscreen controllers

maintainers:
  - Danila Tikhonov <danila@jiaxyga.com>

allOf:
  - $ref: touchscreen.yaml#
  - $ref: /schemas/spi/spi-peripheral-props.yaml#

properties:
  compatible:
    enum:
      - focaltech,ft3680
      - focaltech,ft3683g

  reg:
    maxItems: 1

  interrupts:
    maxItems: 1

  reset-gpios:
    maxItems: 1

  vdd-supply:
    description: Controller analog supply

  iovcc-supply:
    description: Controller I/O supply

  firmware-name:
    description: PRAM firmware file for FT3680

  spi-max-frequency: true
  touchscreen-size-x: true
  touchscreen-size-y: true
  touchscreen-inverted-x: true
  touchscreen-inverted-y: true
  touchscreen-swapped-x-y: true

required:
  - compatible
  - reg
  - interrupts
  - reset-gpios
  - vdd-supply
  - iovcc-supply
  - touchscreen-size-x
  - touchscreen-size-y

unevaluatedProperties: false

if:
  properties:
    compatible:
      const: focaltech,ft3680
then:
  required:
    - firmware-name

examples:
  - |
    #include <dt-bindings/gpio/gpio.h>
    #include <dt-bindings/interrupt-controller/irq.h>

    spi {
        #address-cells = <1>;
        #size-cells = <0>;

        touchscreen@0 {
            compatible = "focaltech,ft3683g";
            reg = <0>;
            spi-max-frequency = <12000000>;
            interrupt-parent = <&gpio>;
            interrupts = <13 IRQ_TYPE_LEVEL_LOW>;
            reset-gpios = <&gpio 16 GPIO_ACTIVE_LOW>;
            vdd-supply = <&vdd_ts>;
            iovcc-supply = <&iovcc_ts>;
            touchscreen-size-x = <1260>;
            touchscreen-size-y = <2800>;
        };
    };
...
```

## Documentation/devicetree/bindings/leds/awinic,aw20144.yaml
```yaml
# SPDX-License-Identifier: (GPL-2.0-only OR BSD-2-Clause)
%YAML 1.2
---
$id: http://devicetree.org/schemas/leds/awinic,aw20144.yaml#
$schema: http://devicetree.org/meta-schemas/core.yaml#

title: Awinic AW20144 matrix LED controller

maintainers:
  - Oleksii Onchul <oleksiionchul@gmail.com>

description: |
  The AW20144 drives up to 144 LEDs using 18 current sinks and eight scan
  switches. Each channel has independent 8-bit PWM and scaling registers.
  Channel numbers are zero-based, with 18 consecutive channels per switch.

properties:
  compatible:
    const: awinic,aw20144

  reg:
    maxItems: 1

  "#address-cells":
    const: 1

  "#size-cells":
    const: 0

  enable-gpios:
    maxItems: 1
    description: GPIO connected to the active-high EN pin.

  awinic,global-current:
    $ref: /schemas/types.yaml#/definitions/uint32
    minimum: 0
    maximum: 255
    description: |
      Global current register (GCCR) value. The peak channel current is
      proportional to this value and is also determined by the external
      ISET resistor. This is a dimensionless register setting, not a
      current in microamps. Select a value appropriate for the board's
      resistor and LEDs.

  awinic,pwm-frequency:
    $ref: /schemas/types.yaml#/definitions/uint32
    enum: [62500, 31250, 15600, 7800, 3900, 1950, 977, 488]
    default: 62500
    description: Nominal PWM clock frequency in Hz, selected for the LED panel.

patternProperties:
  "^led@[0-9a-f]+$":
    type: object
    $ref: common.yaml#
    unevaluatedProperties: false

    properties:
      reg:
        minimum: 0
        maximum: 143
        description: LED channel number.

      default-state:
        const: "off"

    required:
      - reg

required:
  - compatible
  - reg
  - "#address-cells"
  - "#size-cells"
  - enable-gpios
  - awinic,global-current

additionalProperties: false

examples:
  - |
    #include <dt-bindings/gpio/gpio.h>
    #include <dt-bindings/leds/common.h>

    i2c {
        #address-cells = <1>;
        #size-cells = <0>;

        led-controller@20 {
            compatible = "awinic,aw20144";
            reg = <0x20>;
            #address-cells = <1>;
            #size-cells = <0>;
            enable-gpios = <&gpio 8 GPIO_ACTIVE_HIGH>;
            awinic,global-current = <13>;

            led@0 {
                reg = <0>;
                color = <LED_COLOR_ID_WHITE>;
                function = LED_FUNCTION_INDICATOR;
                function-enumerator = <0>;
                default-state = "off";
            };
        };
    };
```

## Documentation/devicetree/bindings/media/i2c/awinic,aw86016.yaml
```yaml
# SPDX-License-Identifier: (GPL-2.0-only OR BSD-2-Clause)
%YAML 1.2
---
$id: http://devicetree.org/schemas/media/i2c/awinic,aw86016.yaml#
$schema: http://devicetree.org/meta-schemas/core.yaml#

title: Awinic AW86016CSR Bidirectional Autofocus Controller

maintainers:
  - Oleksii Onchul <oleksiionchul@gmail.com>

description:
  The AW86016CSR is a bidirectional voice coil motor driver with a 10-bit
  DAC and programmable damping, accessed over I2C. Its power supply range
  is 2.3 to 3.6 volts. Factory configuration is stored in on-chip eNVM.

properties:
  compatible:
    const: awinic,aw86016

  reg:
    maxItems: 1

  vdd-supply:
    description: Motor and controller power supply.

  vio-supply:
    description: Supply for the shared camera module I2C interface and pull-ups.

required:
  - compatible
  - reg
  - vdd-supply
  - vio-supply

additionalProperties: false

examples:
  - |
    i2c {
        #address-cells = <1>;
        #size-cells = <0>;

        lens@c {
            compatible = "awinic,aw86016";
            reg = <0x0c>;
            vdd-supply = <&cam_af>;
            vio-supply = <&cam_io>;
        };
    };
```

## Documentation/devicetree/bindings/media/i2c/dongwoon,dw9827c.yaml
```yaml
# SPDX-License-Identifier: (GPL-2.0-only OR BSD-2-Clause)
%YAML 1.2
---
$id: http://devicetree.org/schemas/media/i2c/dongwoon,dw9827c.yaml#
$schema: http://devicetree.org/meta-schemas/core.yaml#

title: Dongwoon DW9827C Closed-loop Autofocus Controller

maintainers:
  - Oleksii Onchul <oleksiionchul@gmail.com>

description:
  The DW9827C controls an autofocus motor using an internal Hall sensor and
  PID controller. Factory calibration is stored in on-chip nonvolatile
  memory. The controller is accessed over I2C and uses a 2.65 to 3.6 volt
  supply. This driver exposes 12-bit lens positions.

properties:
  compatible:
    const: dongwoon,dw9827c

  reg:
    maxItems: 1

  vdd-supply:
    description: Motor and controller power supply.

  vio-supply:
    description: Supply for the camera module I2C interface.

required:
  - compatible
  - reg
  - vdd-supply
  - vio-supply

additionalProperties: false

examples:
  - |
    i2c {
        #address-cells = <1>;
        #size-cells = <0>;

        lens@f {
            compatible = "dongwoon,dw9827c";
            reg = <0x0f>;
            vdd-supply = <&cam_af>;
            vio-supply = <&cam_io>;
        };
    };
```

## Documentation/devicetree/bindings/media/i2c/samsung,s5kkd1.yaml
```yaml
# SPDX-License-Identifier: (GPL-2.0-only OR BSD-2-Clause)
%YAML 1.2
---
$id: http://devicetree.org/schemas/media/i2c/samsung,s5kkd1.yaml#
$schema: http://devicetree.org/meta-schemas/core.yaml#

title: Samsung S5KKD1 image sensor

maintainers:
  - Oleksii Onchul <oleksiionchul@gmail.com>

description:
  The S5KKD1 is a 32-megapixel image sensor controlled over I2C. The
  supported 3280x2464 RAW10 mode uses four CSI-2 D-PHY data lanes and
  a 19.2 MHz master clock.

allOf:
  - $ref: /schemas/media/video-interface-devices.yaml#

properties:
  compatible:
    const: samsung,s5kkd1

  reg:
    maxItems: 1

  clocks:
    maxItems: 1

  reset-gpios:
    description: Active-low reset input.
    maxItems: 1

  vddio-supply:
    description: Digital I/O supply, 1.8 V.

  vddd-supply:
    description: Digital core supply, 1.05 V.

  vdda-supply:
    description: Analog supply, 2.8 V.

  port:
    $ref: /schemas/graph.yaml#/$defs/port-base
    additionalProperties: false
    properties:
      endpoint:
        $ref: /schemas/media/video-interfaces.yaml#
        unevaluatedProperties: false
        properties:
          data-lanes:
            items:
              - const: 1
              - const: 2
              - const: 3
              - const: 4
          link-frequencies:
            items:
              - const: 638700000
        required:
          - data-lanes
          - link-frequencies

required:
  - compatible
  - reg
  - clocks
  - reset-gpios
  - vddio-supply
  - vddd-supply
  - vdda-supply
  - port

unevaluatedProperties: false

examples:
  - |
    #include <dt-bindings/gpio/gpio.h>

    i2c {
        #address-cells = <1>;
        #size-cells = <0>;

        camera@3d {
            compatible = "samsung,s5kkd1";
            reg = <0x3d>;
            clocks = <&cam_mclk 3>;
            assigned-clocks = <&cam_mclk 3>;
            assigned-clock-rates = <19200000>;
            reset-gpios = <&gpio 126 GPIO_ACTIVE_LOW>;
            vddio-supply = <&vreg_io>;
            vddd-supply = <&vreg_digital>;
            vdda-supply = <&vreg_analog>;

            port {
                endpoint {
                    data-lanes = <1 2 3 4>;
                    link-frequencies = /bits/ 64 <638700000>;
                    remote-endpoint = <&csiphy3_ep>;
                };
            };
        };
    };
```

## Documentation/devicetree/bindings/media/i2c/sony,imx896.yaml
```yaml
# SPDX-License-Identifier: (GPL-2.0-only OR BSD-2-Clause)
%YAML 1.2
---
$id: http://devicetree.org/schemas/media/i2c/sony,imx896.yaml#
$schema: http://devicetree.org/meta-schemas/core.yaml#

title: Sony IMX896 image sensor

maintainers:
  - Oleksii Onchul <oleksiionchul@gmail.com>

description:
  Sony IMX896 is an 8192 by 6144 pixel image sensor. Initial support uses
  a 19.2 MHz input clock and three-trio MIPI CSI-2 C-PHY, with 2 by 2
  binning to produce 4096 by 3072 RAW10 images.

allOf:
  - $ref: /schemas/media/video-interface-devices.yaml#

properties:
  compatible:
    const: sony,imx896

  reg:
    maxItems: 1

  clocks:
    maxItems: 1

  vana1-supply:
    description: 1.8 V analog power supply.

  vana2-supply:
    description: 2.8 V analog power supply.

  vdig-supply:
    description: Digital core power supply.

  vif-supply:
    description: 1.8 V interface power supply.

  reset-gpios:
    description: Reset GPIO, active low.
    maxItems: 1

  port:
    $ref: /schemas/graph.yaml#/$defs/port-base
    additionalProperties: false

    properties:
      endpoint:
        $ref: /schemas/media/video-interfaces.yaml#
        unevaluatedProperties: false

        properties:
          bus-type:
            const: 1

          clock-lanes: false

          data-lanes:
            items:
              - const: 1
              - const: 2
              - const: 3

          link-frequencies:
            items:
              - const: 987789474

        required:
          - bus-type
          - data-lanes
          - link-frequencies

    required:
      - endpoint

required:
  - compatible
  - reg
  - clocks
  - vana1-supply
  - vana2-supply
  - vdig-supply
  - vif-supply
  - port

unevaluatedProperties: false

examples:
  - |
    #include <dt-bindings/gpio/gpio.h>

    i2c {
        #address-cells = <1>;
        #size-cells = <0>;

        camera@10 {
            compatible = "sony,imx896";
            reg = <0x10>;
            clocks = <&camera_mclk 1>;
            assigned-clocks = <&camera_mclk 1>;
            assigned-clock-rates = <19200000>;
            reset-gpios = <&gpio 124 GPIO_ACTIVE_LOW>;
            vana1-supply = <&vreg_1p8_analog>;
            vana2-supply = <&vreg_2p8>;
            vdig-supply = <&vreg_core>;
            vif-supply = <&vreg_1p8_io>;

            port {
                endpoint {
                    bus-type = <1>;
                    data-lanes = <1 2 3>;
                    link-frequencies = /bits/ 64 <987789474>;
                    remote-endpoint = <&csiphy1_ep>;
                };
            };
        };
    };
```
