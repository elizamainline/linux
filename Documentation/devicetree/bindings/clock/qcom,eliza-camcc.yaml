## Documentation/devicetree/bindings/media/qcom,eliza-camss.yaml
```yaml
# SPDX-License-Identifier: (GPL-2.0-only OR BSD-2-Clause)
%YAML 1.2
---
$id: http://devicetree.org/schemas/media/qcom,eliza-camss.yaml#
$schema: http://devicetree.org/meta-schemas/core.yaml#

title: Qualcomm Eliza Camera Subsystem (CAMSS)

maintainers:
  - Oleksii Onchul <oleksiionchul@gmail.com>

description: |
  Eliza (SM7750) has a Titan 970 camera subsystem. This binding describes
  the four CSI PHYs, two test pattern generators and the CSID/IFE Lite
  block used for raw capture.
  The CSID registers precede the VFE registers in a shared window;
  their resources must not overlap. The VFE resource starts at its
  hardware version register, 0x1000 bytes after the CSID resource.

properties:
  compatible:
    const: qcom,eliza-camss

  reg:
    maxItems: 8

  clocks:
    maxItems: 19

  interrupts:
    maxItems: 6

  interconnects:
    maxItems: 2

  iommus:
    maxItems: 1

  power-domains:
    maxItems: 1

  reg-names:
    items:
      - const: csid_lite0
      - const: vfe_lite0
      - const: csiphy0
      - const: csiphy1
      - const: csiphy2
      - const: csiphy3
      - const: tpg0
      - const: tpg1

  clock-names:
    items:
      - const: csiphy0
      - const: csiphy0_timer
      - const: csiphy1
      - const: csiphy1_timer
      - const: csiphy2
      - const: csiphy2_timer
      - const: csiphy3
      - const: csiphy3_timer
      - const: vfe_lite_csid
      - const: vfe_lite_cphy_rx
      - const: gcc_axi_hf
      - const: cpas_ahb
      - const: cpas_fast_ahb
      - const: camnoc_axi
      - const: cpas_ife_lite
      - const: vfe_lite_ahb
      - const: vfe_lite
      - const: tpg
      - const: tpg_cphy_rx

  interrupt-names:
    items:
      - const: csid_lite0
      - const: vfe_lite0
      - const: csiphy0
      - const: csiphy1
      - const: csiphy2
      - const: csiphy3

  interconnect-names:
    items:
      - const: ahb
      - const: hf_0_mnoc

  vdda-phy-supply:
    description: 0.88 V supply to the CSI PHYs.

  vdda-pll-supply:
    description: 1.2 V supply to the CSI PHY PLLs.

  ports:
    $ref: /schemas/graph.yaml#/properties/ports
    description: CSI input ports, one per PHY; only D-PHY is supported.

    patternProperties:
      "^port@[0-3]$":
        $ref: /schemas/graph.yaml#/$defs/port-base
        unevaluatedProperties: false

        properties:
          endpoint:
            $ref: video-interfaces.yaml#
            unevaluatedProperties: false

            properties:
              bus-type:
                const: 4

              data-lanes:
                minItems: 1
                maxItems: 4
                items:
                  minimum: 0
                  maximum: 3

required:
  - compatible
  - reg
  - reg-names
  - clocks
  - clock-names
  - interrupts
  - interrupt-names
  - interconnects
  - interconnect-names
  - iommus
  - power-domains
  - vdda-phy-supply
  - vdda-pll-supply
  - ports

additionalProperties: false
```

## Documentation/devicetree/bindings/net/nfc/st,st21nfc.yaml
```yaml
# SPDX-License-Identifier: GPL-2.0-only OR BSD-2-Clause
%YAML 1.2
---
$id: http://devicetree.org/schemas/net/nfc/st,st21nfc.yaml#
$schema: http://devicetree.org/meta-schemas/core.yaml#

title: STMicroelectronics ST21NFC raw NCI controller

maintainers:
  - Krzysztof Kozlowski <krzk@kernel.org>

description: |
  ST21NFC family controllers which exchange NCI packets directly over I2C,
  without the NDLC framing used by the ST21NFCB and ST21NFCC controllers.

properties:
  compatible:
    const: st,st21nfc

  reg:
    maxItems: 1

  interrupts:
    maxItems: 1

  reset-gpios:
    description: Active-low controller reset line
    maxItems: 1

  clkreq-gpios:
    description: Controller clock request input
    maxItems: 1

required:
  - compatible
  - reg
  - interrupts
  - reset-gpios

additionalProperties: false

examples:
  - |
    #include <dt-bindings/gpio/gpio.h>
    #include <dt-bindings/interrupt-controller/irq.h>

    i2c {
        #address-cells = <1>;
        #size-cells = <0>;

        nfc@8 {
            compatible = "st,st21nfc";
            reg = <0x08>;
            interrupt-parent = <&gpio1>;
            interrupts = <7 IRQ_TYPE_LEVEL_HIGH>;
            reset-gpios = <&gpio1 57 GPIO_ACTIVE_LOW>;
            clkreq-gpios = <&gpio1 6 GPIO_ACTIVE_HIGH>;
        };
    };
```

## Documentation/devicetree/bindings/regulator/awinic,aw37004.yaml
```yaml
# SPDX-License-Identifier: (GPL-2.0-only OR BSD-2-Clause)
%YAML 1.2
---
$id: http://devicetree.org/schemas/regulator/awinic,aw37004.yaml#
$schema: http://devicetree.org/meta-schemas/core.yaml#

title: Awinic AW37004 camera power management IC

maintainers:
  - Oleksii Onchul <oleksiionchul@gmail.com>

description: |
  The AW37004 provides two digital LDOs with 6 mV voltage steps and two
  analog LDOs with 12.5 mV steps. Individual outputs are controlled over
  I2C with the EN input held low.

properties:
  compatible:
    const: awinic,aw37004

  reg:
    maxItems: 1

  enable-gpios:
    description: Active-high EN input, held low for individual I2C control.
    maxItems: 1

  vin1-supply:
    description: Input supply for digital LDO1 and LDO2.

  vin2-supply:
    description: Input and bias supply for analog LDO3 and LDO4.

  regulators:
    type: object
    additionalProperties: false

    patternProperties:
      "^ldo[1-4]$":
        type: object
        $ref: regulator.yaml#
        unevaluatedProperties: false

required:
  - compatible
  - reg
  - regulators
  - vin2-supply

additionalProperties: false

examples:
  - |
    #include <dt-bindings/gpio/gpio.h>

    i2c {
        #address-cells = <1>;
        #size-cells = <0>;

        pmic@28 {
            compatible = "awinic,aw37004";
            reg = <0x28>;
            enable-gpios = <&gpio 54 GPIO_ACTIVE_HIGH>;
            vin1-supply = <&vreg_s2>;
            vin2-supply = <&vreg_bob>;

            regulators {
                ldo1 {
                    regulator-name = "camera-dvdd";
                    regulator-min-microvolt = <1050000>;
                    regulator-max-microvolt = <1050000>;
                };
            };
        };
    };
```

## Documentation/devicetree/bindings/regulator/sgmicro,sgm38120.yaml
```yaml
# SPDX-License-Identifier: (GPL-2.0-only OR BSD-2-Clause)
%YAML 1.2
---
$id: http://devicetree.org/schemas/regulator/sgmicro,sgm38120.yaml#
$schema: http://devicetree.org/meta-schemas/core.yaml#

title: SG Micro SGM38120 camera power management IC

maintainers:
  - Oleksii Onchul <oleksiionchul@gmail.com>

description: |
  The SGM38120 provides seven LDO outputs. LDO1 and LDO2 supply digital
  rails, while LDO3 through LDO7 supply analog and interface rails.
  RESET_B is active low and must be deasserted for I2C communication.

properties:
  compatible:
    const: sgmicro,sgm38120

  reg:
    maxItems: 1

  reset-gpios:
    maxItems: 1

  vin12-supply:
    description: Input supply for LDO1 and LDO2.

  vin34-supply:
    description: Input supply for LDO3 and LDO4.

  vin5-supply:
    description: Input supply for LDO5.

  vin6-supply:
    description: Input supply for LDO6.

  vin7-supply:
    description: Input supply for LDO7.

  regulators:
    type: object
    additionalProperties: false

    patternProperties:
      "^ldo[1-7]$":
        type: object
        $ref: regulator.yaml#
        unevaluatedProperties: false

required:
  - compatible
  - reg
  - reset-gpios
  - regulators

additionalProperties: false

examples:
  - |
    #include <dt-bindings/gpio/gpio.h>

    i2c {
        #address-cells = <1>;
        #size-cells = <0>;

        pmic@35 {
            compatible = "sgmicro,sgm38120";
            reg = <0x35>;
            reset-gpios = <&gpio 5 GPIO_ACTIVE_LOW>;
            vin12-supply = <&vreg_s2>;
            vin34-supply = <&vreg_bob>;
            vin7-supply = <&vreg_bob>;

            regulators {
                ldo2 {
                    regulator-name = "camera-dvdd";
                    regulator-min-microvolt = <1200000>;
                    regulator-max-microvolt = <1200000>;
                };
                ldo4 {
                    regulator-name = "camera-dovdd";
                    regulator-min-microvolt = <1800000>;
                    regulator-max-microvolt = <1800000>;
                };
                ldo7 {
                    regulator-name = "camera-avdd";
                    regulator-min-microvolt = <2800000>;
                    regulator-max-microvolt = <2800000>;
                };
            };
        };
    };
```

## Documentation/devicetree/bindings/sound/awinic,aw88271.yaml
```yaml
# SPDX-License-Identifier: (GPL-2.0-only OR BSD-2-Clause)
%YAML 1.2
---
$id: http://devicetree.org/schemas/sound/awinic,aw88271.yaml#
$schema: http://devicetree.org/meta-schemas/core.yaml#

title: Awinic AW88271 Smart Audio Amplifier

maintainers:
  - Weidong Wang <wangweidong.a@awinic.com>

description:
  The AW88271 is an I2S input smart speaker amplifier configured over I2C.
  Multiple amplifiers may share an I2S bus and use separate audio channels.

allOf:
  - $ref: dai-common.yaml#

properties:
  compatible:
    const: awinic,aw88271

  reg:
    maxItems: 1

  '#sound-dai-cells':
    const: 0

  reset-gpios:
    maxItems: 1

  firmware-name:
    maxItems: 1
    description: Name of the amplifier configuration file

  awinic,audio-channel:
    $ref: /schemas/types.yaml#/definitions/uint32
    description: Channel index used to select the amplifier configuration
    minimum: 0
    maximum: 7

required:
  - compatible
  - reg
  - '#sound-dai-cells'
  - reset-gpios
  - awinic,audio-channel

unevaluatedProperties: false

examples:
  - |
    #include <dt-bindings/gpio/gpio.h>

    i2c {
        #address-cells = <1>;
        #size-cells = <0>;

        audio-codec@34 {
            compatible = "awinic,aw88271";
            reg = <0x34>;
            #sound-dai-cells = <0>;
            reset-gpios = <&gpio 146 GPIO_ACTIVE_LOW>;
            awinic,audio-channel = <0>;
            firmware-name = "aw882xx_acf.bin";
        };
    };
```
